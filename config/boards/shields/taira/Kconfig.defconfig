## config/boards/shields/taira/Kconfig.defconfig
```kconfig
if SHIELD_TAIRA_LEFT

config ZMK_KEYBOARD_NAME
	default "Taira"

config ZMK_SPLIT_ROLE_CENTRAL
    default y

endif

if SHIELD_TAIRA_LEFT || SHIELD_TAIRA_RIGHT

config ZMK_SPLIT
	default y

endif
```
